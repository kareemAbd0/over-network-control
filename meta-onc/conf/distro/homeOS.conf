## meta-onc/conf/distro/homeOS.conf
```bitbake
# Distro Layer configuration
# include and overwrite default poky distro
include conf/distro/poky.conf
DISTRO = "homeOS"
DISTRO_NAME = "homeOS"
DISTRO_VERSION = "1.0"


# Use systemd as init manager
INIT_MANAGER = "systemd"
```

## meta-onc/conf/layer.conf
```bitbake
# We have a conf and classes directory, add to BBPATH
BBPATH .= ":${LAYERDIR}"

# We have recipes-* directories, add to BBFILES
BBFILES += "${LAYERDIR}/recipes-*/*/*.bb \
            ${LAYERDIR}/recipes-*/*/*.bbappend"

BBFILE_COLLECTIONS += "meta-onc"
BBFILE_PATTERN_meta-onc = "^${LAYERDIR}/"
BBFILE_PRIORITY_meta-onc = "6"

LAYERDEPENDS_meta-onc = "core"
LAYERSERIES_COMPAT_meta-onc = "kirkstone"
```
